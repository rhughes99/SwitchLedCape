/* Device Tree Overlay for playing with switches and LEDs on Switch LED Cape
*  This overlay is for GPIOs and PRU 0
*  09/20/2016
*/
/dts-v1/;
/plugin/;

/ {
   compatible = "ti,beaglebone", "ti,beaglebone-black";

   part-number = "SLED-Overlay";
   version = "00A0";

   /* This overlay uses the following resources */
   exclusive-use = "P8.11", "P8.15", "pru0";

   fragment@0 {
      target = <&am33xx_pinmux>;
      __overlay__ {

      pru_pru_pins: pinmux_pru_pru_pins {            // PRU pin modes
            pinctrl-single,pins = <
               0x034 0x0E  //    LED  P8_11 pr1_pru0_pru_r30_15, MODE 6 | OUT | DIS 0000 1110=0x0E
               0x03C 0x2E  // SWITCH  P8_15 pr1_pru0_pru_r31_15, MODE 6 |  IN | DIS 0010 1110=0x2E
            >;
         };
      };
   };

   fragment@1 {         // Enable PRUSS
      target = <&pruss>;
      __overlay__ {
         status = "okay";
         pinctrl-names = "default";
         pinctrl-0 = <&pru_pru_pins>;
      };
   };
};
